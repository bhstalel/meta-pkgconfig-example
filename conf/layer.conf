## conf/layer.conf
```bitbake
BBPATH .= ":${LAYERDIR}"

BBFILES += "${LAYERDIR}/recipes-*/*/*.bb \
	    ${LAYERDIR}/recipes-*/*/*.bbappend"

BBFILE_COLLECTIONS += "meta-pkgconfig-example"
BBFILE_PATTERN_meta-pkgconfig-example = "^${LAYERDIR}/"
BBFILE_PRIORITY_meta-pkgconfig-example = "6"

LAYERDEPENDS_meta-pkgconfig-example = "core"
LAYERSERIES_COMPAT_meta-pkgconfig-example = "dunfell"
```
